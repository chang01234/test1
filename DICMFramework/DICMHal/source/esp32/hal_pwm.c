/*! \file hal_pwm.c
	\brief HAL for PWM
*/
#include "dicm_framework_config.h"
#ifdef HAL_PWM
#include "iGeneralDefinitions.h"
#include "hal_pwm.h"
#include "driver/mcpwm.h"


// Storage for user ISR callbacks
static hal_pwm_cap_isr_cb_t hal_pwm_isr_cb[MCPWM_UNIT_MAX][MCPWM_SELECT_CAP2+1];

static bool pwm_cap_isr_cb(mcpwm_unit_t mcpwm, mcpwm_capture_channel_id_t cap_channel, const cap_event_data_t *edata, void *user_data);
static uint8_t hal_pwm_get_config(uint8_t pwm_ch_num, mcpwm_timer_t* timer_num, mcpwm_generator_t* gen_num);

 
/*! \brief MCPWM ISR callback
 *
 *  Just forward the isr to user. Note that those are executing in ISR contect.
 * 
 * 	\param 	mcpwm MCPWM unit number
 * 	\param 	cap_channel Capture channel (0-2)
 * 	\param 	edata Pointer to capture event data, generated by library (capture value)
 * 	\param 	user_data Pointer to user given data structure (may not be used)
 *
 *  \return bool is yielding from ISR calls are required before leaving ISR 
 */
static bool pwm_cap_isr_cb(mcpwm_unit_t mcpwm, mcpwm_capture_channel_id_t cap_channel, const cap_event_data_t *edata, void *user_data)
{
    bool yield = false;
    if (hal_pwm_isr_cb[mcpwm][cap_channel])
    {
        yield = hal_pwm_isr_cb[mcpwm][cap_channel](mcpwm, cap_channel, edata->cap_value);
    }

    return yield;
}

/*! \brief Gets MCPWM operator details for selected device
 *
 * 	\param 	dev_sel Selection of the device.
 *
 */
static uint8_t hal_pwm_get_config(uint8_t pwm_ch_num, mcpwm_timer_t* timer_num, mcpwm_generator_t* gen_num)
{
    // Todo remove from here. See pin config
    static const struct 
    {
        mcpwm_timer_t timer;
        mcpwm_generator_t gen;
    } capture_config[] = 
    {
        {
            .timer = MCPWM_TIMER_0,
            .gen = MCPWM_GEN_A,
        },
        {
            .timer = MCPWM_TIMER_0,
            .gen = MCPWM_GEN_B,
        },
        {
            .timer = MCPWM_TIMER_1,
            .gen = MCPWM_GEN_A,
        },
    };

	uint8_t err = 0;

    if (pwm_ch_num < ELEMENTS(capture_config))
    {
        *timer_num = capture_config[pwm_ch_num].timer;
        *gen_num = capture_config[pwm_ch_num].gen;
    }
    else
    {
        err = -1;
    }
	return err;
}

/*! \brief Initializing mcpwm gpio pins.
 *
 */
void hal_pwm_init_gpio(uint8_t unit)
{
    if (unit == MCPWM_UNIT_0)
    {
        // TODO Add config defines for all fields
        const mcpwm_pin_config_t pin_config = 
        {
            .mcpwm0a_out_num        = MCPWM_UNIT_0_GPIO_PWM0A_OUT,
            .mcpwm0b_out_num        = MCPWM_UNIT_0_GPIO_PWM0B_OUT,
            .mcpwm1a_out_num        = MCPWM_UNIT_0_GPIO_PWM1A_OUT,
            .mcpwm1b_out_num        = -1,                                                 //Not used
            .mcpwm2a_out_num        = -1,                                                 //Not used 
            .mcpwm2b_out_num        = -1,                                                 //Not used
            .mcpwm_cap0_in_num      = MCPWM_UNIT_0_GPIO_CAP0_IN,
            .mcpwm_cap1_in_num      = MCPWM_UNIT_0_GPIO_CAP1_IN,
            .mcpwm_cap2_in_num      = MCPWM_UNIT_0_GPIO_CAP2_IN,
            .mcpwm_sync0_in_num     = -1,                                             //Not used
            .mcpwm_sync1_in_num     = -1,                                             //Not used
            .mcpwm_sync2_in_num     = -1,                                             //Not used
            .mcpwm_fault0_in_num    = -1,                                             //Not used
            .mcpwm_fault1_in_num    = -1,                                             //Not used
            .mcpwm_fault2_in_num    = -1                                              //Not used
        };
        mcpwm_set_pin(MCPWM_UNIT_0, &pin_config);
    }
	else
    {
        LOG(E, "No support for MCPWM_UNIT_1 yet");
    }
}

/*! \brief hal_init_pwm
 *
 * 	\param[in] 	unit MCPWM unit number (0-1)
 */
void hal_pwm_init(uint8_t unit)
{
    //2. initial mcpwm configuration
    mcpwm_config_t pwm_config;
    pwm_config.frequency = DEVICE_PWM_FREQUENCY;                               // frequency = 25000Hz
    pwm_config.cmpr_a = 100.0;                                                 // duty cycle of PWMxA = 0.0%
    pwm_config.cmpr_b = 100.0;                                                 // duty cycle of PWMxb = 0.0%
    pwm_config.counter_mode = MCPWM_UP_COUNTER;
    pwm_config.duty_mode = MCPWM_DUTY_MODE_0;
#ifdef HAL_PWM_TIMER_0
    mcpwm_init(unit, MCPWM_TIMER_0, &pwm_config);                      // Configure PWM0A & PWM0B with above settings
#endif
#ifdef HAL_PWM_TIMER_1
	mcpwm_init(unit, MCPWM_TIMER_1, &pwm_config);                      // Configure PWM1A & PWM1B with above settings
#endif
#ifdef HAL_PWM_TIMER_2
	mcpwm_init(unit, MCPWM_TIMER_2, &pwm_config);                      // Configure PWM1A & PWM1B with above settings
#endif
}

/*! \brief hal_pwm_capture_enable
 *
 * 	\param[in] 	mcpwm MCPWM unit number
 * 	\param[in] 	capture_signal Capture signal/channel (0-2)
 *  \param[in]  capture_edge Trigger type of ISR
 *  \param[in]  cb ISR callback to be called for this interrupt
 */
void hal_pwm_capture_enable(uint8_t unit, uint8_t capture_signal, hal_pwm_capture_edge_type_t capture_edge, hal_pwm_cap_isr_cb_t cb)
{
    //3. Capture configuration
    //configure CAP0, CAP1 and CAP2 signal to start capture counter on rising edge
    //In general practice you can connect Capture to external signal, measure time between rising edge or falling edge and take action accordingly
   
    mcpwm_capture_on_edge_t cap_edge = (mcpwm_capture_on_edge_t)capture_edge;
    if (cap_edge > MCPWM_BOTH_EDGE)
    {
        cap_edge = MCPWM_BOTH_EDGE;
    }

    const mcpwm_capture_config_t cap_conf = 
    {
        .cap_edge = cap_edge,
        .cap_prescale = 1,
        .capture_cb = pwm_cap_isr_cb,
        .user_data = NULL
    };
    mcpwm_capture_enable_channel(unit, capture_signal, &cap_conf);
    
    hal_pwm_isr_cb[unit][capture_signal] = cb;
}

/*! \brief HAL function to set the duty cycle
 *
 * 	\param[in] 	mcpwm MCPWM unit number
 * 	\param[in] 	capture_signal Capture signal/channel (0-2)
 * 	\param[in] 	duty_cycle Selection of the device.
 *
 */
void hal_pwm_set_duty_cycle(uint8_t unit, uint8_t pwm_channel, uint32_t duty_cycle)
{
    uint8_t err;
    mcpwm_timer_t timer_num;
    mcpwm_generator_t gen_num;
    
    err = hal_pwm_get_config(pwm_channel, &timer_num, &gen_num);
    
    if ( err == 0 )
    {
        mcpwm_set_duty(unit, timer_num, gen_num, (float)duty_cycle);
    }
}

#endif // HAL_PWM
