/*! \file hal_nvmc.c
	\brief Non-Volatile memory Hardware Abstraction Layer
*/

/** Includes ******************************************************************/
#include "hal_nvmc.h"

#include <stdint.h>
#include <stdbool.h>
#include <string.h>

#include "app_error.h"
#include "app_util_platform.h"
#include "fds.h"
#include "nrf_pwr_mgmt.h"

/** Defines *******************************************************************/

typedef struct WAITING_TASK
{
    fds_evt_id_t    event;
    uint16_t        file_id;
    uint16_t        key;
    bool            done;
} WAITING_TASK;

/** Variables *****************************************************************/
static volatile WAITING_TASK waiting_task = {0};    //!< Holds data about currently pending FDS task.
static bool init_complete = false;                  //!< True if NVMC HAL has been initialized.
static uint8_t data_buf[200] __ALIGN(4);            //!< 4-aligned buffer for holding data while it is written to flash

/** Private functions *********************************************************/

/*! \brief Returns true only if key is valid and allowed for use with FDS.
 *
 *  \param key  Key to be validated.
 *
 *  \returns True if key is valid else false.
 */
static bool key_valid(uint32_t key)
{
    uint16_t file_id = (uint16_t)(key >> 16);
    uint16_t record_key = (uint16_t)key;
    
    return (file_id < 0xC000) && (record_key != 0x0000) && (record_key < 0xC000);
}

/*! \brief Prepares HAL for handling an asynchronous FDS task.
 *
 *  This function initializes the waiting_task struct which will be used by
 *  \p wait_for_fds_task to determine when pending task is complete. It must
 *  be called before calling FDS when FDS handles task asynchronously.
 *
 *  \param event    Event generated by task when complete.
 *  \param file_id  File id of task. 0 for tasks which do not affect FDS files.
 *  \param fds_key  Record key of task. 0 for tasks which do not affect FDS records.
 */
static void prepare_fds_task(fds_evt_id_t event, uint16_t file_id, uint16_t fds_key)
{   
    waiting_task.event = event;
    waiting_task.file_id = file_id;
    waiting_task.key = fds_key;
    waiting_task.done = false;
}

/*! \brief Waits until pending asynchronous FDS task is complete then returns.
 *
 *  \p prepare_fds_task must be called before this function. FDS interface call
 *  that starts the asynchronous task to wait for must be called after calling
 *  \p prepare_fds_task but before calling this function.
 */
static void wait_for_fds_task(void)
{   
    while (!waiting_task.done)
    {
        nrf_pwr_mgmt_run();
    }
}

//*! \brief event handler for FDS.
static void	fds_evt_handler(fds_evt_t const	* const	p_fds_evt)
{
	
	if (p_fds_evt->id == waiting_task.event)
	{
		switch (p_fds_evt->id)
		{
			case FDS_EVT_INIT:
			case FDS_EVT_GC:
				APP_ERROR_CHECK(p_fds_evt->result);
				waiting_task.done =	true;
				break;
			case FDS_EVT_WRITE:
			case FDS_EVT_UPDATE:
				if ((p_fds_evt->write.file_id == waiting_task.file_id) && (p_fds_evt->write.record_key == waiting_task.key))
				{
					APP_ERROR_CHECK(p_fds_evt->result);
					waiting_task.done =	true;
				}
				break;
			case FDS_EVT_DEL_RECORD:
				if ((p_fds_evt->del.file_id	== waiting_task.file_id) &&	(p_fds_evt->del.record_key == waiting_task.key))
				{
					APP_ERROR_CHECK(p_fds_evt->result);
					waiting_task.done =	true;
				}
				break;
		}
	}
}

/** Public functions **********************************************************/

HAL_NVMC_RESULT_ENUM hal_nvmc_init(void)
{ 
    ret_code_t rc = NRF_SUCCESS;
    
    if (!init_complete)
    {
        prepare_fds_task(FDS_EVT_INIT, 0, 0);
        APP_ERROR_CHECK(fds_register(fds_evt_handler));
        APP_ERROR_CHECK(fds_init());
        wait_for_fds_task();
        init_complete = true;
    }	

    return HAL_NVMC_OK;   //If we reach this point no error occurred.
}

HAL_NVMC_RESULT_ENUM hal_nvmc_write(uint32_t key, const void *buffer, uint16_t len)
{
    fds_find_token_t  tok  = {0};
    fds_record_desc_t record_desc = {0};
    ret_code_t rc;
    
    fds_record_t record = { 
        .file_id = (uint16_t)(key >> 16), 
        .key = (uint16_t)key, 
        .data.p_data = data_buf, 
        .data.length_words = (len + 3) / sizeof(uint32_t), // convert the length in bytes to length in words.
    };

    APP_ERROR_CHECK_BOOL(init_complete);                                        // HAL must be initialized before writing to flash.
    APP_ERROR_CHECK_BOOL(key_valid(key));                                       // Invalid record key.
    APP_ERROR_CHECK_BOOL(len <= sizeof(data_buf)/sizeof(data_buf[0]));          // Data must fit in write buffer.
    APP_ERROR_CHECK_BOOL(current_int_priority_get() == APP_IRQ_PRIORITY_THREAD);// Flash writes are not allowed from interrupts.

    memcpy(data_buf, buffer, len);   // Copy data into correctly aligned data buffer.
    
    rc = fds_record_find(record.file_id, record.key, &record_desc, &tok);

    if (rc == NRF_SUCCESS)
    {   // If key exists update it.
    
        prepare_fds_task(FDS_EVT_UPDATE, record.file_id, record.key);
        rc = fds_record_update(&record_desc, &record);
        if (rc == NRF_SUCCESS)
        {
            wait_for_fds_task();
        }
        else if (rc == FDS_ERR_NO_SPACE_IN_FLASH)
        {
            prepare_fds_task(FDS_EVT_GC, 0, 0);
            APP_ERROR_CHECK(fds_gc());
            wait_for_fds_task();
            
            prepare_fds_task(FDS_EVT_UPDATE, record.file_id, record.key);
            APP_ERROR_CHECK(fds_record_update(&record_desc, &record));
            wait_for_fds_task();
        }
        else
        {   // Assert on unhandled errors.
            APP_ERROR_CHECK(rc);
        }
        
    }
    else if (rc == FDS_ERR_NOT_FOUND)
    {   // If key does not exist create a new record with key.
        
        prepare_fds_task(FDS_EVT_WRITE, record.file_id, record.key);
        rc = fds_record_write(&record_desc, &record);
        if (rc == NRF_SUCCESS)
        {
            wait_for_fds_task();
        }
        else if (rc == FDS_ERR_NO_SPACE_IN_FLASH)
        {   
            
            prepare_fds_task(FDS_EVT_GC, 0, 0);
            APP_ERROR_CHECK(fds_gc());
            wait_for_fds_task();
            
            prepare_fds_task(FDS_EVT_WRITE, record.file_id, record.key);
            APP_ERROR_CHECK(fds_record_write(&record_desc, &record));
            wait_for_fds_task();
        }
        else
        {   // Assert on unhandled errors.
            APP_ERROR_CHECK(rc);
        }
        
    }
    else
    {   // Assert on unhandled errors.
        APP_ERROR_CHECK(rc);
    }
    
    return HAL_NVMC_OK;   //If we reach this point no error occurred.
}

HAL_NVMC_RESULT_ENUM hal_nvmc_read(uint32_t key, void *buffer, uint16_t len)
{
    fds_find_token_t  tok  = {0};
    fds_record_desc_t record_desc = {0};
    fds_flash_record_t flash_record = {0};
    ret_code_t rc;
    
    APP_ERROR_CHECK_BOOL(init_complete);    // HAL must be initialized before writing to flash.
    APP_ERROR_CHECK_BOOL(key_valid(key));   // Invalid record key.

    rc = fds_record_find((uint16_t)(key >> 16), (uint16_t)key, &record_desc, &tok);
  
    if (rc == NRF_SUCCESS)
    {
        rc = fds_record_open(&record_desc, &flash_record);
        if (rc == NRF_SUCCESS)
        {
            memcpy(buffer, flash_record.p_data, len);
            APP_ERROR_CHECK(fds_record_close(&record_desc));
        }
        else if (rc == FDS_ERR_CRC_CHECK_FAILED)
        {
            APP_ERROR_CHECK(fds_record_close(&record_desc));            
            
            return HAL_NVMC_CRC_CHECK_FAILED;
        }
        else
        {   // Assert on unhandled errors.
            APP_ERROR_CHECK(rc);
        }
    }
    else if (rc = FDS_ERR_NOT_FOUND)
    {
        return HAL_NVMC_KEY_NOT_FOUND;
    }
    else
    {   // Assert on unhandled errors.
        APP_ERROR_CHECK(rc);
    }

    return HAL_NVMC_OK;   //If we reach this point no error occurred.
}

HAL_NVMC_RESULT_ENUM hal_nvmc_delete(uint32_t key)
{
    fds_find_token_t  tok  = {0};
    fds_record_desc_t record_desc = {0};
    ret_code_t rc;
        
    APP_ERROR_CHECK_BOOL(init_complete);                                        // HAL must be initialized before writing to flash.
    APP_ERROR_CHECK_BOOL(key_valid(key));                                       // Invalid record key.
    APP_ERROR_CHECK_BOOL(current_int_priority_get() == APP_IRQ_PRIORITY_THREAD);// Flash deletes are not allowed from interrupts.

    rc = fds_record_find((uint16_t)(key >> 16), (uint16_t)key, &record_desc, &tok);
  
    if (rc == NRF_SUCCESS)
    {
        prepare_fds_task(FDS_EVT_DEL_RECORD, (uint16_t)(key >> 16), (uint16_t)key);
        APP_ERROR_CHECK(fds_record_delete(&record_desc));
        wait_for_fds_task();
    }
    else if (rc = FDS_ERR_NOT_FOUND)
    {
        return HAL_NVMC_KEY_NOT_FOUND;
    }
    else
    {   // Assert on unhandled errors.
        APP_ERROR_CHECK(rc);
    }

    return HAL_NVMC_OK;   //If we reach this point no error occurred.
}