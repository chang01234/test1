## DICMFramework/components/modem/Kconfig
```kconfig
menu "IOT Modem"

config MODEM_APN
    string "Modem APN"
    default "dometic.cxn"
    help
        Default endpoint host name to connect to

config MODEM_UART_TX_PIN
    int "Modem UART TX Pin"
    default 25
    help
        UART TX pin number 

config MODEM_UART_RX_PIN
    int "Modem UART RX Pin"
    default 39
    help
        UART RX pin number 

config MODEM_UART_RTS_PIN
    int "Modem UART RTS Pin"
    default -1
    help
        UART RTS pin number (-1 = not used)

config MODEM_UART_CTS_PIN
    int "Modem UART CTS Pin"
    default -1
    help
        UART CTS pin number (-1 = not used)

config MODEM_PPP_AUTH_USERNAME
    string "Modem PPP Auth Username"
    default ""
    help
        PPP Username to use when authorizing connection

config MODEM_PPP_AUTH_PASSWORD
    string "Modem PPP Auth Password"
    default ""
    help
        PPP Password to use when authorizing connection

endmenu  # IOT Modem
```

## DICMFramework/sdkconfig/4.x/sdkconfig.defaults
```kconfig
# partition table
CONFIG_PARTITION_TABLE_CUSTOM=y
CONFIG_PARTITION_TABLE_CUSTOM_FILENAME="DICMFramework/partitions.csv"

# Make build fully reproducable
CONFIG_APP_COMPILE_TIME_DATE=n
CONFIG_BOOTLOADER_LOG_LEVEL_WARN=y
CONFIG_BOOTLOADER_LOG_LEVEL_INFO=n
CONFIG_BOOTLOADER_LOG_LEVEL=2

# boot
CONFIG_PARTITION_TABLE_OFFSET=0x10000
CONFIG_SECURE_SIGNED_APPS_NO_SECURE_BOOT=y
CONFIG_SECURE_BOOT_SIGNING_KEY="DICMFramework/secure_boot_signing_key.pem"

# flash
CONFIG_ESPTOOLPY_FLASHMODE_QIO=y
CONFIG_ESPTOOLPY_FLASHSIZE_4MB=y
CONFIG_ESPTOOLPY_FLASHSIZE="4MB"

# ipc
CONFIG_ESP_IPC_USES_CALLERS_PRIORITY=n

# WiFi
CONFIG_ESP32_WIFI_NVS_ENABLED=n
CONFIG_ESP32_WIFI_STATIC_RX_BUFFER_NUM=16
CONFIG_ESP32_WIFI_STATIC_TX_BUFFER=y
CONFIG_ESP32_WIFI_TX_BUFFER_TYPE=0
CONFIG_ESP32_WIFI_STATIC_TX_BUFFER_NUM=8
CONFIG_ESP32_WIFI_RX_BA_WIN=16
CONFIG_ESP32_WIFI_RX_IRAM_OPT=n
CONFIG_WPA_MBEDTLS_CRYPTO=n

# Bluetooth
CONFIG_BT_ENABLED=y
CONFIG_BTDM_CTRL_MODE_BLE_ONLY=y
CONFIG_BT_GATTS_ENABLE=y
CONFIG_BT_GATTC_ENABLE=n
CONFIG_BT_ACL_CONNECTIONS=1
CONFIG_BTDM_CTRL_BLE_MAX_CONN=9
CONFIG_BT_BTC_TASK_STACK_SIZE=4096
CONFIG_BTDM_CTRL_BLE_MAX_CONN_EFF=9
CONFIG_BT_NIMBLE_MAX_CONNECTIONS=9
CONFIG_BT_NIMBLE_MAX_BONDS=10
CONFIG_BT_NIMBLE_TASK_STACK_SIZE=6144
CONFIG_BTDM_LPCLK_SEL_EXT_32K_XTAL=y
CONFIG_BT_NIMBLE_ENABLED=y
CONFIG_BT_NIMBLE_MEM_ALLOC_MODE_DEFAULT=y
CONFIG_BTDM_COEX_BT_OPTIONS=y
CONFIG_BTDM_COEX_BLE_ADV_HIGH_PRIORITY=y
CONFIG_BT_NIMBLE_ACL_BUF_COUNT=40
CONFIG_BTDM_CTRL_PINNED_TO_CORE_1=y
CONFIG_BTDM_CTRL_PINNED_TO_CORE=1
CONFIG_BT_NIMBLE_LOG_LEVEL_WARNING=y
CONFIG_BT_NIMBLE_LOG_LEVEL=2
CONFIG_BT_NIMBLE_PINNED_TO_CORE_1=y
CONFIG_BT_NIMBLE_PINNED_TO_CORE=1
CONFIG_BT_NIMBLE_MSYS1_BLOCK_COUNT=24
CONFIG_BT_NIMBLE_ENABLE_CONN_REATTEMPT=y

# FreeRTOS
CONFIG_FREERTOS_SUPPORT_STATIC_ALLOCATION=y
CONFIG_FREERTOS_TIMER_TASK_PRIORITY=4
CONFIG_FREERTOS_TIMER_TASK_STACK_DEPTH=3072
CONFIG_FREERTOS_ISR_STACKSIZE=3072

# Logging
CONFIG_LOG_DEFAULT_LEVEL_INFO=y
CONFIG_LOG_DEFAULT_LEVEL=3
CONFIG_LOG_MAXIMUM_LEVEL_DEBUG=y
CONFIG_LOG_MAXIMUM_LEVEL=4

# LWIP
CONFIG_LWIP_USE_ONLY_LWIP_SELECT=y
CONFIG_LWIP_TCP_MAXRTX=3
CONFIG_LWIP_TCP_SYNMAXRTX=3
CONFIG_LWIP_TCP_MSS=1440
CONFIG_LWIP_TCPIP_CORE_LOCKING=n
#CONFIG_LWIP_IRAM_OPTIMIZATION=y
CONFIG_LWIP_IP4_REASSEMBLY=y
#CONFIG_LWIP_SLIP_SUPPORT=y
CONFIG_LWIP_IPV6=n
CONFIG_LWIP_SO_LINGER=y
CONFIG_LWIP_TCPIP_RECVMBOX_SIZE=16


# external RAM
CONFIG_ESP32_SPIRAM_SUPPORT=y
CONFIG_BT_ALLOCATION_FROM_SPIRAM_FIRST=y
CONFIG_SPIRAM_BOOT_INIT=y
CONFIG_SPIRAM_USE_MALLOC=y
CONFIG_SPIRAM_TYPE_AUTO=y
CONFIG_SPIRAM_SIZE=-1
CONFIG_SPIRAM_SPEED_40M=y
CONFIG_SPIRAM_MEMTEST=y
CONFIG_SPIRAM_CACHE_WORKAROUND=n
CONFIG_SPIRAM_MALLOC_ALWAYSINTERNAL=128
CONFIG_SPIRAM_TRY_ALLOCATE_WIFI_LWIP=y
CONFIG_SPIRAM_MALLOC_RESERVE_INTERNAL=65536
CONFIG_SPIRAM_ALLOW_BSS_SEG_EXTERNAL_MEMORY=y
CONFIG_D0WD_PSRAM_CLK_IO=17
CONFIG_D0WD_PSRAM_CS_IO=16
CONFIG_D2WD_PSRAM_CLK_IO=9
CONFIG_D2WD_PSRAM_CS_IO=10
CONFIG_PICO_PSRAM_CS_IO=10
CONFIG_MBEDTLS_EXTERNAL_MEM_ALLOC=y
CONFIG_SPIRAM_BANKSWITCH_ENABLE=n

# system
CONFIG_HEAP_POISONING_DISABLED=y
CONFIG_ESP_SYSTEM_EVENT_TASK_STACK_SIZE=3584

# time
CONFIG_ESP_SYSTEM_RTC_EXT_XTAL_BOOTSTRAP_CYCLES=5
CONFIG_LWIP_SNTP_UPDATE_DELAY=86400000

# WDT
CONFIG_ESP_TASK_WDT_TIMEOUT_S=10

# OTA
CONFIG_OTA_ALLOW_HTTP=y

# ethernet
CONFIG_ETH_ENABLED=n
CONFIG_ETH_USE_ESP32_EMAC=n
CONFIG_ETH_PHY_INTERFACE_RMII=n
CONFIG_ETH_USE_SPI_ETHERNET=n

# timer
CONFIG_FREERTOS_TIMER_QUEUE_LENGTH=20
CONFIG_FREERTOS_CHECK_MUTEX_GIVEN_BY_OWNER=n

# PPP
CONFIG_LWIP_PPP_SUPPORT=y
CONFIG_LWIP_PPP_NOTIFY_PHASE_SUPPORT=y
CONFIG_LWIP_PPP_PAP_SUPPORT=y

# SSL/TLS
CONFIG_MBEDTLS_PSK_MODES=y
CONFIG_MBEDTLS_KEY_EXCHANGE_PSK=y
CONFIG_MBEDTLS_KEY_EXCHANGE_DHE_PSK=y
CONFIG_MBEDTLS_KEY_EXCHANGE_ECDHE_PSK=y
CONFIG_MBEDTLS_KEY_EXCHANGE_RSA_PSK=y
CONFIG_MBEDTLS_SSL_PROTO_DTLS=y
CONFIG_OPENSSL_ASSERT_DO_NOTHING=y

# IOT SDK
CONFIG_AWS_IOT_SDK=y
CONFIG_AWS_IOT_MQTT_HOST="abolbw5uma8g3-ats.iot.us-east-2.amazonaws.com"
CONFIG_AWS_IOT_MQTT_PORT=8883
CONFIG_AWS_IOT_MQTT_TX_BUF_LEN=4096
CONFIG_AWS_IOT_MQTT_RX_BUF_LEN=4096
CONFIG_AWS_IOT_MQTT_NUM_SUBSCRIBE_HANDLERS=12
CONFIG_AWS_IOT_MQTT_MIN_RECONNECT_WAIT_INTERVAL=1000
CONFIG_AWS_IOT_MQTT_MAX_RECONNECT_WAIT_INTERVAL=128000
CONFIG_AWS_IOT_SHADOW_MAX_SIZE_OF_UNIQUE_CLIENT_ID_BYTES=80
CONFIG_AWS_IOT_SHADOW_MAX_SIMULTANEOUS_ACKS=10
CONFIG_AWS_IOT_SHADOW_MAX_SIMULTANEOUS_THINGNAMES=10
CONFIG_AWS_IOT_SHADOW_MAX_JSON_TOKEN_EXPECTED=120
CONFIG_AWS_IOT_SHADOW_MAX_SHADOW_TOPIC_LENGTH_WITHOUT_THINGNAME=60
CONFIG_AWS_IOT_SHADOW_MAX_SIZE_OF_THING_NAME=20

# debug
CONFIG_COMPILER_STACK_CHECK_MODE_NORM=y
CONFIG_COMPILER_STACK_CHECK=y
#CONFIG_COMPILER_OPTIMIZATION_DEFAULT=y
CONFIG_COMPILER_OPTIMIZATION_SIZE=y
CONFIG_COMPILER_OPTIMIZATION_ASSERTIONS_ENABLE=y

# CERTIFICATES
CONFIG_EXAMPLE_EMBEDDED_CERTS=y

# local
CONFIG_WPA_MBEDTLS_CRYPTO=n

#mdns
CONFIG_MDNS_TASK_STACK_SIZE=2448

# Twai configurations
CONFIG_TWAI_ISR_IN_IRAM=y
CONFIG_TWAI_ERRATA_FIX_BUS_OFF_REC=y
CONFIG_TWAI_ERRATA_FIX_TX_INTR_LOST=y
CONFIG_TWAI_ERRATA_FIX_RX_FRAME_INVALID=y
CONFIG_TWAI_ERRATA_FIX_RX_FIFO_CORRUPT=y
```

## DICMFramework/sdkconfig/4.x/sdkconfig.defaults.devsec
```kconfig
#
# Security
#
CONFIG_SECURE_SIGNED_ON_BOOT=y
CONFIG_SECURE_SIGNED_ON_UPDATE=y
CONFIG_SECURE_SIGNED_APPS=y
CONFIG_SECURE_ESP32_SUPPORTS_RSA=y
CONFIG_SECURE_BOOT_SUPPORTS_RSA=y
CONFIG_SECURE_SIGNED_APPS_RSA_SCHEME=y
CONFIG_SECURE_BOOT=y
CONFIG_SECURE_BOOT_V2_ENABLED=y
CONFIG_SECURE_BOOT_BUILD_SIGNED_BINARIES=y
CONFIG_SECURE_BOOT_SIGNING_KEY="DICMFramework/secure_boot_signing_key_dev.pem"
CONFIG_SECURE_FLASH_ENC_ENABLED=y
CONFIG_SECURE_FLASH_ENCRYPTION_MODE_DEVELOPMENT=y

#
# Partition Table
#
CONFIG_PARTITION_TABLE_CUSTOM=y
CONFIG_PARTITION_TABLE_CUSTOM_FILENAME="DICMFramework/partitions_sec.csv"

#
# eFuse Bit Manager
#
CONFIG_EFUSE_VIRTUAL=y
CONFIG_EFUSE_VIRTUAL_KEEP_IN_FLASH=y
CONFIG_EFUSE_CODE_SCHEME_COMPAT_3_4=y
CONFIG_EFUSE_MAX_BLK_LEN=192
# end of eFuse Bit Manager
```

## DICMFramework/sdkconfig/4.x/sdkconfig.defaults.esp32
```kconfig
# target
CONFIG_IDF_TARGET_ESP32=y
CONFIG_IDF_TARGET="esp32"

# chip
CONFIG_ESP32_REV_MIN_3=y
CONFIG_ESP32_REV_MIN=3

# time
# Use internal 8M256 RTC oscillator, when EXT_CRYS is evaluated as good, switch to it.
# Evaluation and switching is done in `rtc_watchdog.c`.
# CONFIG_ESP32_TIME_SYSCALL_USE_RTC is not set
# CONFIG_ESP32_TIME_SYSCALL_USE_FRC1 is not set
# CONFIG_ESP32_TIME_SYSCALL_USE_NONE is not set
# CONFIG_ESP32_RTC_CLK_SRC_INT_RC is not set
# CONFIG_ESP32_RTC_CLK_SRC_EXT_CRYS is not set
# CONFIG_ESP32_RTC_CLK_SRC_EXT_OSC is not set
CONFIG_ESP32_RTC_CLK_SRC_INT_8MD256=y
CONFIG_ESP32_RTC_CLK_CAL_CYCLES=3000

CONFIG_BTDM_SCAN_DUPL_TYPE=0
CONFIG_BTDM_SCAN_DUPL_CACHE_SIZE=200
CONFIG_BTDM_SCAN_DUPL_CACHE_REFRESH_PERIOD=0
```

## DICMFramework/sdkconfig/4.x/sdkconfig.defaults.esp32c3
```kconfig
# target
CONFIG_IDF_TARGET_ESP32c3=y
CONFIG_IDF_TARGET="esp32c3"

CONFIG_ESP32C3_DEBUG_OCDAWARE=n

# Bluetooth
CONFIG_BT_CTRL_BLE_MAX_ACT=5
CONFIG_BT_CTRL_SCAN_DUPL_TYPE=0
CONFIG_BT_CTRL_SCAN_DUPL_CACHE_SIZE=150
CONFIG_BT_CTRL_DUPL_SCAN_CACHE_REFRESH_PERIOD=0

#
# LWIP
#
CONFIG_LWIP_MAX_SOCKETS=6

# Nimble
CONFIG_BT_NIMBLE_ACL_BUF_COUNT=20
CONFIG_BT_NIMBLE_MAX_CONNECTIONS=5
CONFIG_BT_NIMBLE_HOST_BASED_PRIVACY=y
CONFIG_BT_NIMBLE_USE_ESP_TIMER=y
CONFIG_BT_NIMBLE_ENABLE_CONN_REATTEMPT=n
CONFIG_BT_NIMBLE_MAX_CONN_REATTEMPT=3
CONFIG_BT_NIMBLE_HS_FLOW_CTRL=y

# Wifi
CONFIG_ESP32_WIFI_IRAM_OPT=y
CONFIG_ESP32_WIFI_STATIC_RX_BUFFER_NUM=4
CONFIG_ESP32_WIFI_DYNAMIC_RX_BUFFER_NUM=8
CONFIG_ESP32_WIFI_DYNAMIC_TX_BUFFER=y
CONFIG_ESP32_WIFI_TX_BUFFER_TYPE=1
CONFIG_ESP32_WIFI_DYNAMIC_TX_BUFFER_NUM=8
CONFIG_ESP32_WIFI_AMPDU_RX_ENABLED=n
CONFIG_ESP32_WIFI_AMPDU_TX_ENABLED=n

#
# Security features
#
CONFIG_SECURE_BOOT_SIGNING_KEY="DICMFramework/secure_boot_signing_key_rsa.pem"
# end of Security features


#system 
CONFIG_ESP_MAIN_TASK_STACK_SIZE=4584

#
# Heap memory debugging
#
CONFIG_HEAP_ABORT_WHEN_ALLOCATION_FAILS=y

# time
# Use internal 8M256 RTC oscillator, when EXT_CRYS is evaluated as good, switch to it.
# Evaluation and switching is done in `rtc_watchdog.c`.
# CONFIG_ESP32C3_TIME_SYSCALL_USE_RTC is not set
# CONFIG_ESP32C3_TIME_SYSCALL_USE_FRC1 is not set
# CONFIG_ESP32C3_TIME_SYSCALL_USE_NONE is not set
# CONFIG_ESP32C3_RTC_CLK_SRC_INT_RC is not set
# CONFIG_ESP32C3_RTC_CLK_SRC_EXT_CRYS is not set
# CONFIG_ESP32C3_RTC_CLK_SRC_EXT_OSC is not set
CONFIG_ESP32C3_RTC_CLK_SRC_INT_8MD256=y
CONFIG_ESP32C3_RTC_CLK_CAL_CYCLES=3000
```

## DICMFramework/sdkconfig/4.x/sdkconfig.defaults.esp32s3
```kconfig
# target
CONFIG_IDF_TARGET_ESP32s3=y
CONFIG_IDF_TARGET="esp32s3"
CONFIG_BT_NIMBLE_HOST_BASED_PRIVACY=y

#
# Security features
#
CONFIG_SECURE_BOOT_SIGNING_KEY="DICMFramework/secure_boot_signing_key_rsa.pem"
# end of Security features

CONFIG_ESP32S3_RTC_CLK_SRC_INT_8MD256=y
CONFIG_ESP32S3_RTC_CLK_CAL_CYCLES=3000

# ESP32S3-Specific
CONFIG_ESP32S3_BROWNOUT_DET_LVL_SEL_7=y
CONFIG_ESP32S3_SPIRAM_SUPPORT=y
CONFIG_SPIRAM_MODE_QUAD=n
CONFIG_SPIRAM_MODE_OCT=y
CONFIG_SPIRAM_MALLOC_RESERVE_INTERNAL=65536
CONFIG_SPIRAM_USE_MALLOC=y
CONFIG_SPIRAM_MALLOC_ALWAYSINTERNAL=128
CONFIG_SPIRAM_TRY_ALLOCATE_WIFI_LWIP=y
CONFIG_SPIRAM_ALLOW_BSS_SEG_EXTERNAL_MEMORY=y

# PHY
CONFIG_ESP_PHY_ENABLE_USB=n

# BLE
CONFIG_BT_NIMBLE_MAX_CONNECTIONS=8
CONFIG_BT_NIMBLE_HS_FLOW_CTRL=y
# MODEM SLEEP Options
CONFIG_BT_CTRL_MODEM_SLEEP=y

# WiFi
CONFIG_ESP32_WIFI_IRAM_OPT=n
```

## DICMFramework/sdkconfig/4.x/sdkconfig.defaults.linux
```kconfig
# target
CONFIG_IDF_TARGET_LINUX=y
CONFIG_IDF_TARGET="linux"

CONFIG_FREERTOS_UNICORE=y
CONFIG_MDNS_PREDEF_NETIF_STA=n
CONFIG_MDNS_PREDEF_NETIF_AP=n
CONFIG_FREERTOS_USE_TICK_HOOK=y
```

## DICMFramework/sdkconfig/5.x/sdkconfig.defaults.8MB.secure
```kconfig
#
# Configuration settings with Platform Security for Development
# - Secure Boot V2 enabled
# - Flash Encryption (Development) enabled
# - Disabled PPP and mDNS network services
#
# Use `idf.py encrypted-flash` to update the firmware on the device.
#

CONFIG_PARTITION_TABLE_CUSTOM_FILENAME="DICMFramework/partitions_8MB_secure.csv"

#
# Security features
#
CONFIG_SECURE_SIGNED_ON_BOOT=y
CONFIG_SECURE_SIGNED_ON_UPDATE=y
CONFIG_SECURE_SIGNED_APPS=y
CONFIG_SECURE_SIGNED_APPS_RSA_SCHEME=y
CONFIG_SECURE_BOOT=y
CONFIG_SECURE_BOOT_V2_ENABLED=y
CONFIG_SECURE_BOOT_BUILD_SIGNED_BINARIES=y
CONFIG_SECURE_BOOT_FLASH_BOOTLOADER_DEFAULT=y
CONFIG_SECURE_DISABLE_ROM_DL_MODE=n
CONFIG_SECURE_FLASH_ENC_ENABLED=y
CONFIG_SECURE_FLASH_ENCRYPTION_MODE_DEVELOPMENT=y
CONFIG_SECURE_FLASH_UART_BOOTLOADER_ALLOW_ENC=y
CONFIG_SECURE_FLASH_ENCRYPT_ONLY_IMAGE_LEN_IN_APP_PART=y
CONFIG_SECURE_FLASH_CHECK_ENC_EN_IN_APP=y
CONFIG_SECURE_INSECURE_ALLOW_DL_MODE=y

#
# Disabled Network Services
#

CONFIG_LWIP_DNS_SUPPORT_MDNS_QUERIES=n
CONFIG_LWIP_PPP_SUPPORT=n

CONFIG_MDNS_ENABLE_CONSOLE_CLI=n
CONFIG_MDNS_MULTIPLE_INSTANCE=n
CONFIG_MDNS_PREDEF_NETIF_STA=n
```

## DICMFramework/sdkconfig/5.x/sdkconfig.defaults.boot.dev
```kconfig
# Secure Boot Signing Key for Development build

#
# Security features
#
CONFIG_SECURE_BOOT_SIGNING_KEY="DICMFramework/secure_boot_signing_key_dev.pem"
```

## DICMFramework/sdkconfig/5.x/sdkconfig.defaults.boot.prod
```kconfig
# Secure Boot Signing Key for Production build

#
# Security features
#
CONFIG_SECURE_BOOT_SIGNING_KEY="secure_boot_signing_key.pem"
```

## DICMFramework/sdkconfig/5.x/sdkconfig.defaults.esp32
```kconfig
# target
CONFIG_IDF_TARGET_ESP32=y
CONFIG_IDF_TARGET="esp32"

# chip
CONFIG_ESP32_REV_MIN_3=y
CONFIG_ESP32_REV_MIN=3

# External ram
CONFIG_SPIRAM=y
CONFIG_BT_ALLOCATION_FROM_SPIRAM_FIRST=y
CONFIG_SPIRAM_BOOT_INIT=y
CONFIG_SPIRAM_USE_MALLOC=y
CONFIG_SPIRAM_TYPE_AUTO=y
CONFIG_SPIRAM_SPEED_40M=y
CONFIG_SPIRAM_MEMTEST=y
CONFIG_SPIRAM_MALLOC_ALWAYSINTERNAL=128
CONFIG_SPIRAM_TRY_ALLOCATE_WIFI_LWIP=y
CONFIG_SPIRAM_MALLOC_RESERVE_INTERNAL=65536
CONFIG_SPIRAM_ALLOW_BSS_SEG_EXTERNAL_MEMORY=y
CONFIG_D0WD_PSRAM_CLK_IO=17
CONFIG_D0WD_PSRAM_CS_IO=16
CONFIG_D2WD_PSRAM_CLK_IO=9
CONFIG_D2WD_PSRAM_CS_IO=10
CONFIG_PICO_PSRAM_CS_IO=10
CONFIG_SPIRAM_BANKSWITCH_ENABLE=n

CONFIG_SPIRAM_CACHE_WORKAROUND=n

# time
CONFIG_RTC_CLK_SRC_INT_8MD256=y
CONFIG_RTC_CLK_SRC_EXT_CRYS=n
# CONFIG_RTC_XTAL_CAL_RETRY=10
CONFIG_RTC_CLK_CAL_CYCLES=3000

# Bluetooth
CONFIG_BTDM_CTRL_PINNED_TO_CORE_1=y
CONFIG_BTDM_CTRL_PINNED_TO_CORE=1
CONFIG_BTDM_CTRL_BLE_MAX_CONN=9
CONFIG_BTDM_CTRL_BLE_MAX_CONN_EFF=9
CONFIG_BTDM_CTRL_MODE_BLE_ONLY=y
CONFIG_BTDM_SCAN_DUPL_TYPE=0
CONFIG_BTDM_SCAN_DUPL_CACHE_SIZE=200
CONFIG_BTDM_SCAN_DUPL_CACHE_REFRESH_PERIOD=0
CONFIG_BT_NIMBLE_HOST_BASED_PRIVACY=y
```

## DICMFramework/sdkconfig/5.x/sdkconfig.defaults.esp32c2
```kconfig
# target
CONFIG_IDF_TARGET_ESP32C2=y
CONFIG_IDF_TARGET="esp32c2"

CONFIG_ESP_DEFAULT_CPU_FREQ_MHZ_120=y
CONFIG_ESP_DEFAULT_CPU_FREQ_MHZ=120

# Bluetooth
CONFIG_BT_LE_SLEEP_ENABLE=y
CONFIG_BT_CTRL_RUN_IN_FLASH_ONLY=y

#
# LWIP
#
CONFIG_LWIP_MAX_SOCKETS=6
CONFIG_LWIP_TCPIP_TASK_STACK_SIZE=2048


# Nimble
CONFIG_BT_NIMBLE_TRANSPORT_ACL_FROM_LL_COUNT=20
CONFIG_BT_NIMBLE_MAX_CONNECTIONS=3
CONFIG_BT_NIMBLE_ENABLE_CONN_REATTEMPT=n
CONFIG_BT_NIMBLE_MAX_CONN_REATTEMPT=3
CONFIG_BT_NIMBLE_HS_FLOW_CTRL=y
CONFIG_BT_NIMBLE_GATT_MAX_PROCS=5
CONFIG_BT_NIMBLE_ROLE_BROADCASTER=y

# Wifi
CONFIG_ESP_WIFI_STATIC_RX_BUFFER_NUM=4
CONFIG_ESP_WIFI_DYNAMIC_RX_BUFFER_NUM=8
CONFIG_ESP_WIFI_DYNAMIC_TX_BUFFER=y
CONFIG_ESP_WIFI_TX_BUFFER_TYPE=1
CONFIG_ESP_WIFI_DYNAMIC_TX_BUFFER_NUM=8
CONFIG_ESP_WIFI_AMPDU_RX_ENABLED=n
CONFIG_ESP_WIFI_AMPDU_TX_ENABLED=n
CONFIG_ESP_WIFI_IRAM_OPT=n
CONFIG_ESP_WIFI_RX_IRAM_OPT=n
CONFIG_ESP_WIFI_SLP_IRAM_OPT=n

#
# Security features
#
CONFIG_SECURE_BOOT_SIGNING_KEY="DICMFramework/secure_boot_signing_key_rsa.pem"
# end of Security features


#system 
CONFIG_ESP_DEBUG_OCDAWARE=n

#
# Heap memory debugging
#
CONFIG_HEAP_ABORT_WHEN_ALLOCATION_FAILS=y

# time
CONFIG_RTC_CLK_SRC_INT_8MD256=y
CONFIG_RTC_CLK_CAL_CYCLES=3000

# FreeRTOS
CONFIG_FREERTOS_USE_TICKLESS_IDLE=y
CONFIG_FREERTOS_IDLE_TIME_BEFORE_SLEEP=3
CONFIG_FREERTOS_IDLE_TASK_STACKSIZE=1160
CONFIG_FREERTOS_PLACE_FUNCTIONS_INTO_FLASH=y

# Wireless Coexistence
CONFIG_ESP_COEX_ENABLED=y

# ESP Ringbuf
CONFIG_RINGBUF_PLACE_FUNCTIONS_INTO_FLASH=y
CONFIG_RINGBUF_PLACE_ISR_FUNCTIONS_INTO_FLASH=y
CONFIG_RINGBUF_PLACE_FUNCTIONS_INTO_FLASH=y

# ESP Timer (High Resolution Timer)
CONFIG_ESP_TIMER_TASK_STACK_SIZE=2048

# TCP
CONFIG_LWIP_TCP_SND_BUF_DEFAULT=4096
CONFIG_LWIP_TCP_WND_DEFAULT=5760

# ESP-Driver:SPI Configurations
CONFIG_SPI_SLAVE_IN_IRAM=n
CONFIG_SPI_SLAVE_ISR_IN_IRAM=n

# Newlib
CONFIG_NEWLIB_NANO_FORMAT=y

# Event Loop Library
CONFIG_ESP_EVENT_POST_FROM_ISR=n
CONFIG_ESP_EVENT_POST_FROM_IRAM_ISR=n


# Compiler options
CONFIG_COMPILER_OPTIMIZATION_SIZE=y
CONFIG_COMPILER_SAVE_RESTORE_LIBCALLS=y
CONFIG_COMPILER_OPTIMIZATION_ASSERTIONS_SILENT=y
```
